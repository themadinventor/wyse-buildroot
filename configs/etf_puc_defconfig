## configs/etf_puc_defconfig
```kconfig
BR2_x86_geode=y
BR2_CCACHE=y
BR2_TOOLCHAIN_BUILDROOT_LARGEFILE=y
BR2_TOOLCHAIN_BUILDROOT_WCHAR=y
BR2_TARGET_GENERIC_HOSTNAME="puc"
BR2_TARGET_GENERIC_ISSUE="Tonight, we dine in hell!"
BR2_TARGET_GENERIC_GETTY_PORT="console"
BR2_LINUX_KERNEL=y
BR2_LINUX_KERNEL_PATCH="board/etf/puc/geode-fixes.linux-3.13.5.patch"
BR2_LINUX_KERNEL_USE_CUSTOM_CONFIG=y
BR2_LINUX_KERNEL_CUSTOM_CONFIG_FILE="board/etf/puc/linux-puc.config"
BR2_PACKAGE_BUSYBOX_CONFIG="board/etf/puc/busybox.config"
BR2_PACKAGE_BUSYBOX_SHOW_OTHERS=y
BR2_PACKAGE_ALSA_UTILS=y
BR2_PACKAGE_MPLAYER=y
BR2_PACKAGE_BZIP2=y
BR2_PACKAGE_E2FSPROGS=y
# BR2_PACKAGE_E2FSPROGS_BADBLOCKS is not set
# BR2_PACKAGE_E2FSPROGS_CHATTR is not set
# BR2_PACKAGE_E2FSPROGS_DUMPE2FS is not set
# BR2_PACKAGE_E2FSPROGS_E2FREEFRAG is not set
# BR2_PACKAGE_E2FSPROGS_E2LABEL is not set
# BR2_PACKAGE_E2FSPROGS_E2UNDO is not set
# BR2_PACKAGE_E2FSPROGS_FILEFRAG is not set
# BR2_PACKAGE_E2FSPROGS_FINDFS is not set
# BR2_PACKAGE_E2FSPROGS_LOGSAVE is not set
# BR2_PACKAGE_E2FSPROGS_LSATTR is not set
# BR2_PACKAGE_E2FSPROGS_MKLOSTFOUND is not set
# BR2_PACKAGE_E2FSPROGS_TUNE2FS is not set
# BR2_PACKAGE_E2FSPROGS_UUIDGEN is not set
BR2_PACKAGE_FLASHROM=y
BR2_PACKAGE_PICOCOM=y
BR2_PACKAGE_DROPBEAR=y
BR2_PACKAGE_NTP=y
# BR2_PACKAGE_NTP_NTPD is not set
BR2_PACKAGE_NTP_NTPDATE=y
BR2_TARGET_ROOTFS_CPIO=y
BR2_TARGET_ROOTFS_CPIO_BZIP2=y
BR2_TARGET_ROOTFS_TAR_BZIP2=y
BR2_TARGET_SYSLINUX=y
# BR2_TARGET_SYSLINUX_ISOLINUX is not set
# BR2_TARGET_SYSLINUX_PXELINUX is not set
```
